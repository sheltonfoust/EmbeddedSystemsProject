/**
 * @cliArgs --board "/ti/boards/MSP_EXP432E401Y" --product "simplelink_msp432e4_sdk@4.20.00.12"
 * @versions {"data":"2020050718","timestamp":"2020050718","tool":"1.5.0+1353","templates":"2020050718"}
 */

/**
 * Import the modules used in this configuration.
 */
const GPIO  = scripting.addModule("/ti/drivers/GPIO");
const GPIO1 = GPIO.addInstance();
const GPIO2 = GPIO.addInstance();
const GPIO3 = GPIO.addInstance();
const GPIO4 = GPIO.addInstance();
const GPIO5 = GPIO.addInstance();
const GPIO6 = GPIO.addInstance();
const GPIO7 = GPIO.addInstance();
const GPIO8 = GPIO.addInstance();
const RTOS  = scripting.addModule("/ti/drivers/RTOS");
const UART  = scripting.addModule("/ti/drivers/UART");
const UART1 = UART.addInstance();

/**
 * Write custom configuration values to the imported modules.
 */
GPIO1.$name     = "CONFIG_GPIO_0";
GPIO1.$hardware = system.deviceData.board.components.D1;

GPIO2.$name     = "CONFIG_GPIO_1";
GPIO2.$hardware = system.deviceData.board.components.D2;

GPIO3.$name     = "CONFIG_GPIO_2";
GPIO3.$hardware = system.deviceData.board.components.D3;

GPIO4.$name     = "CONFIG_GPIO_3";
GPIO4.$hardware = system.deviceData.board.components.D4;

GPIO5.$name           = "CONFIG_GPIO_4";
GPIO5.gpioPin.$assign = "boosterpack2.38";

GPIO6.$name           = "CONFIG_GPIO_5";
GPIO6.mode            = "Output";
GPIO6.gpioPin.$assign = "expansion.40";

GPIO7.$name            = "CONFIG_GPIO_6";
GPIO7.$hardware        = system.deviceData.board.components.USR_SW1;
GPIO7.interruptTrigger = "None";
GPIO7.callbackFunction = "";

GPIO8.$name            = "CONFIG_GPIO_7";
GPIO8.$hardware        = system.deviceData.board.components.USR_SW2;
GPIO8.interruptTrigger = "None";
GPIO8.callbackFunction = "";


UART1.$name     = "CONFIG_UART_0";
UART1.$hardware = system.deviceData.board.components.XDS110UART;

/**
 * Pinmux solution for unlocked pins/peripherals. This ensures that minor changes to the automatic solver in a future
 * version of the tool will not impact the pinmux you originally saw.  These lines can be completely deleted in order to
 * re-solve from scratch.
 */
GPIO1.gpioPin.$suggestSolution        = "expansion.87";
GPIO2.gpioPin.$suggestSolution        = "expansion.85";
GPIO3.gpioPin.$suggestSolution        = "expansion.64";
GPIO4.gpioPin.$suggestSolution        = "expansion.66";
GPIO7.gpioPin.$suggestSolution        = "expansion.82";
GPIO8.gpioPin.$suggestSolution        = "expansion.84";
RTOS.timer0.resource.$suggestSolution = "Timer0";
UART1.uart.$suggestSolution           = "UART0";
UART1.uart.txPin.$suggestSolution     = "expansion.76";
UART1.uart.rxPin.$suggestSolution     = "expansion.74";
